## arch/riscv/core/pmp/Kconfig
```kconfig
# Physical Memory Protection (PMP) configuration options

# Copyright (c) 2020 BayLibre, SAS
# SPDX-License-Identifier: Apache-2.0

config PMP_SLOT
	int "Number of PMP slot"
	default 8 if CORE_E31
	help
	  Depend of the board. Take care to don't put value higher than
	  The Hardware allow you.
```
