## sample.yaml
```
sample:
  description: syscall performances sample
  name: syscall performances
```

## prj.conf
```kconfig
CONFIG_USERSPACE=y
CONFIG_APPLICATION_DEFINED_SYSCALL=y
CONFIG_ASSERT=y
CONFIG_LOG=y
CONFIG_LOG_MINIMAL=y
CONFIG_MAIN_STACK_SIZE=2560
CONFIG_CORE_E31=y
```

## src/main.c
```c
/*
 * Copyright (c) 2020 BayLibre, SAS
 *
 * SPDX-License-Identifier: Apache-2.0
 */

#include <zephyr.h>
#include <stdio.h>

#include "main.h"
#include "thread_def.h"

void main(void)
{
	printf("Main Thread started; %s\n", CONFIG_BOARD);

	k_thread_create(&supervisor_thread, supervisor_stack, THREAD_STACKSIZE,
			supervisor_thread_function, NULL, NULL, NULL,
			-1, K_INHERIT_PERMS, 0);

	k_sleep(1000);

	k_thread_create(&user_thread, user_stack, THREAD_STACKSIZE,
			user_thread_function, NULL, NULL, NULL,
			-1, K_USER | K_INHERIT_PERMS, 0);
}
```

## src/test_supervisor.c
```c
/*
 * Copyright (c) 2020 BayLibre, SAS
 *
 * SPDX-License-Identifier: Apache-2.0
 */

#include <zephyr.h>
#include <stdio.h>

#include "main.h"

/*
 * 0xB00 is CSR mcycle
 * 0xB02 is CSR minstret
 */
void supervisor_thread_function(void *p1, void *p2, void *p3)
{
	register unsigned long cycle_before, cycle_count;
	register unsigned long inst_before, inst_count;

	printf("Supervisor thread started\n");

	while (1) {
		k_sleep(K_MSEC(2000));

		inst_before = csr_read(0xB02);
		cycle_before = csr_read(0xB00);
		k_current_get();
		cycle_count = csr_read(0xB00);
		inst_count = csr_read(0xB02);

		if (cycle_count > cycle_before)
			cycle_count -= cycle_before;
		else
			cycle_count += 0xFFFFFFFF - cycle_before;

		if (inst_count > inst_before)
			inst_count -= inst_before;
		else
			inst_count += 0xFFFFFFFF - inst_before;

		/* Remove CSR accesses to be more accurate */
		inst_count -= 3;

		printf("Supervisor thread:\t%8lu cycles\t%8lu instructions\n",
			cycle_count, inst_count);
	}
}
```

## src/test_user.c
```c
/*
 * Copyright (c) 2020 BayLibre, SAS
 *
 * SPDX-License-Identifier: Apache-2.0
 */

#include <zephyr.h>
#include <stdio.h>

#include "main.h"

/*
 * 0xC00 is CSR cycle
 * 0xC02 is CSR instret
 */
void user_thread_function(void *p1, void *p2, void *p3)
{
	register unsigned long cycle_before, cycle_count;
	register unsigned long inst_before, inst_count;

	printf("User thread started\n");

	while (1) {
		k_sleep(K_MSEC(2000));

		inst_before = csr_read(0xC02);
		cycle_before = csr_read(0xC00);
		k_current_get();
		cycle_count = csr_read(0xC00);
		inst_count = csr_read(0xC02);

		if (cycle_count > cycle_before)
			cycle_count -= cycle_before;
		else
			cycle_count += 0xFFFFFFFF - cycle_before;

		if (inst_count > inst_before)
			inst_count -= inst_before;
		else
			inst_count += 0xFFFFFFFF - inst_before;

		/* Remove CSR accesses to be more accurate */
		inst_count -= 3;

		printf("User thread:\t\t%8lu cycles\t%8lu instructions\n",
			cycle_count, inst_count);
	}
}
```
